## TFG/main/Kconfig.projbuild
```kconfig
# put here your custom config value
menu "Example Configuration"
config ESP_WIFI_SSID
    string "WiFi SSID"
    default "myssid"
    help
	SSID (network name) for the example to connect to.

config ESP_WIFI_PASSWORD
    string "WiFi Password"
    default "mypassword"
    help
	WiFi password (WPA or WPA2) for the example to use.
config EXAMPLE_SCAN_LIST_SIZE
    int "Max size of scan list"
    range 0 20
    default 10
    help
        The size of array that will be used to retrieve the list of access points.
endmenu
```

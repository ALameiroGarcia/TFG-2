#include "driver/i2c.h"
#include "esp_log.h"
#include <string.h>
#include "esp_sntp.h"

#define I2C_MASTER_SCL_IO 22
#define I2C_MASTER_SDA_IO 21
#define I2C_MASTER_NUM I2C_NUM_0
#define I2C_MASTER_FREQ_HZ 400000
#define SSD1306_ADDR 0x3C  // Dirección I2C común para SSD1306
#define SSD1306_COL_OFFSET 2

// Enviar comandos al SSD1306
static esp_err_t ssd1306_send_cmd(uint8_t cmd) {
    i2c_cmd_handle_t handle = i2c_cmd_link_create();
    esp_err_t err;

    i2c_master_start(handle);
    i2c_master_write_byte(handle, (SSD1306_ADDR << 1) | I2C_MASTER_WRITE, true);

    // Control byte: Co=0, D/C#=0 indica comando
    i2c_master_write_byte(handle, 0x00, true);

    i2c_master_write_byte(handle, cmd, true);

    i2c_master_stop(handle);
    err = i2c_master_cmd_begin(I2C_MASTER_NUM, handle, pdMS_TO_TICKS(1000));
    i2c_cmd_link_delete(handle);
    return err;
}

// Enviar datos (por ejemplo, buffer de pantalla)
static esp_err_t ssd1306_send_data(const uint8_t* data, size_t len) {
    i2c_cmd_handle_t handle = i2c_cmd_link_create();
    esp_err_t err;

    i2c_master_start(handle);
    i2c_master_write_byte(handle, (SSD1306_ADDR << 1) | I2C_MASTER_WRITE, true);

    // Control byte: Co=0, D/C#=1 indica datos
    i2c_master_write_byte(handle, 0x40, true);

    i2c_master_write(handle, data, len, true);

    i2c_master_stop(handle);
    err = i2c_master_cmd_begin(I2C_MASTER_NUM, handle, pdMS_TO_TICKS(1000));
    i2c_cmd_link_delete(handle);
    return err;
}

// Inicialización básica del SSD1306 128x64
void ssd1306_init(void) {
    // Estas secuencias las puedes ajustar según el datasheet
    uint8_t init_cmds[] = {
        0xAE,             // Display off
        0x20, 0x00,       // Memory addressing mode: horizontal
        0xB0,             // Page Start Address for Page Addressing Mode
        0xC8,             // COM Output Scan Direction: remapped mode
        0x00,             // low column start address
        0x10,             // high column start address
        0x40,             // start line address
        0x81, 0x7F,       // contrast control
        0xA1,             // segment remap
        0xA6,             // normal display (A7 for inverse)
        0xA8, 0x3F,       // multiplex ratio (1/64)
        0xA4,             // output RAM to display
        0xD3, 0x00,       // display offset
        0xD5, 0x80,       // display clock divide ratio/oscillator frequency
        0xD9, 0xF1,       // pre-charge period
        0xDA, 0x12,       // COM pins hardware configuration
        0xDB, 0x40,       // vcomh deselect level
        0x8D, 0x14,       // charge pump setting (enable)
        0xAF              // display on
    };

    for (int i = 0; i < sizeof(init_cmds); i++) {
        ssd1306_send_cmd(init_cmds[i]);
    }
}

// Limpiar pantalla (borrar buffer y enviar)
void ssd1306_clear(void) {
    static uint8_t buffer[128 * 64 / 8];
    memset(buffer, 0x00, sizeof(buffer));
    // Enviar buffer página por página
    for (uint8_t page = 0; page < 8; page++) {
        ssd1306_send_cmd(0xB0 + page); // set page address
        ssd1306_send_cmd(0x00);        // set low col address
        ssd1306_send_cmd(0x10);        // set high col address
        ssd1306_send_data(&buffer[128 * page], 128);
    }
}

// Ejemplo: dibujar un carácter 8x8 usando una fuente básica
static uint8_t font8x8_basic[128][8] = {
    { 0x00, 0x00, 0x00, 0x00, 0x00, 0x00, 0x00, 0x00 },   // U+0000 (nul)
    { 0x00, 0x04, 0x02, 0xFF, 0x02, 0x04, 0x00, 0x00 },   // U+0001 (Up Allow)
    { 0x00, 0x20, 0x40, 0xFF, 0x40, 0x20, 0x00, 0x00 },   // U+0002 (Down Allow)
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    { 0x00, 0x00, 0x00, 0x00, 0x00, 0x00, 0x00, 0x00 },    // U+007F
};

void ssd1306_draw_char(uint8_t x, uint8_t page, char c) {
    if (c < 0x20 || c > 0x7F) c = '?'; // Caracteres imprimibles básicos

    uint8_t col = x + SSD1306_COL_OFFSET;

    ssd1306_send_cmd(0xB0 + page);                        // Set page address
    ssd1306_send_cmd(0x00 + (col & 0x0F));                // Set lower column address
    ssd1306_send_cmd(0x10 + ((col >> 4) & 0x0F));         // Set higher column address

    ssd1306_send_data(font8x8_basic[(uint8_t)c], 8);      // Send 8-byte character
}

void ssd1306_draw_string(uint8_t x_start, uint8_t page, const char* str) {
    uint8_t x = x_start;
    while (*str && page < 8) {
        ssd1306_draw_char(x, page, *str++);
        x += 8;
        if (x > 120) {
            x = x_start;
            page++;
        }
    }
}
#include <time.h>

// Mostrar mensaje en líneas intermedias (páginas 1 a 6)
void hud_display_message(const char* msg, uint8_t page) {
    // Limpiar línea
    for (uint8_t x = 0; x < 16; x++) {
        ssd1306_draw_char(x * 8, page, ' ');
    }
    ssd1306_draw_string(0, page, msg);
}

// Mostrar hora arriba izquierda (página 0, columna 0)
void hud_display_time(int hour, int minute, int second) {
    char buf[9];
    snprintf(buf, sizeof(buf), "%02d:%02d:%02d", hour, minute, second);

    // Limpia donde irá la hora (col 0 a 9)
    for (uint8_t x = 0; x < 16; x++) {
        ssd1306_draw_char(x, 0, ' ');
    }
    ssd1306_draw_string(0, 0, buf);
}

void hud_display_wifi(bool connected) {
    // Limpiar posición (3 caracteres para ON/OFF)


    if (connected) {
        ssd1306_draw_string(0, 5, "Wi-Fi ON ");
    } else {
        ssd1306_draw_string(0, 5, "Wi-Fi OFF");
    }
}

// Mostrar estado del sensor en la última línea (página 7)
void hud_display_sensor_status(bool sensor_ok) {
    // Limpiar línea completa (128 columnas / 8 pixels por char = 16 chars)
    for (uint8_t x = 0; x < 16; x++) {
        ssd1306_draw_char(x * 8, 6, ' ');
    }
    if (sensor_ok) {
        ssd1306_draw_string(0, 6, "SENSOR OK");
    } else {
        ssd1306_draw_string(0, 6, "SENSOR ERROR");
    }
}
// Tarea que actualiza el HUD OLED cada segundo
void oled_hud_task(void *pvParameters) {
    ssd1306_clear();
    ssd1306_draw_string(0,1,"----------------");
    while (1) {
        time_t now;
        struct tm timeinfo;

        time(&now);
        gmtime_r(&now, &timeinfo);

        hud_display_time(timeinfo.tm_hour, timeinfo.tm_min, timeinfo.tm_sec);

        vTaskDelay(pdMS_TO_TICKS(1000));
    }
}

// Función para inicializar todo (I2C + pantalla)
void oled_init(void) {
    ssd1306_init();
    ssd1306_clear();
}